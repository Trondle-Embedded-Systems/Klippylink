## esp32-s3/sdkconfig.defaults
```kconfig
CONFIG_PARTITION_TABLE_CUSTOM=y
CONFIG_PARTITION_TABLE_CUSTOM_FILENAME="partitions.csv"
CONFIG_ESPTOOLPY_FLASHSIZE_4MB=y
CONFIG_BT_ENABLED=y
CONFIG_BT_BLUEDROID_ENABLED=y
CONFIG_BT_BLE_ENABLED=y
CONFIG_SPIFFS_MAX_PARTITIONS=3
CONFIG_ESP_DEFAULT_CPU_FREQ_MHZ_240=y
```

## node/main/Kconfig
```kconfig
menu "KlipNode Configuration"

choice KLIPNODE_VARIANT
    prompt "Node hardware variant"
    default KLIPNODE_VARIANT_MINIMAL
    help
        Select the hardware variant to compile. FULL adds WiFi, a web config UI,
        and a PID heater control loop (requires ESP32-S3 recommended). MINIMAL
        is BLE-only and fits on ESP32-C3/C5.

    config KLIPNODE_VARIANT_FULL
        bool "Full (ESP32-S3): WiFi, web config UI, PID heater"
    config KLIPNODE_VARIANT_MINIMAL
        bool "Minimal (ESP32-C3/C5): BLE only"
endchoice

endmenu
```

## router/sdkconfig.defaults
```kconfig
CONFIG_PARTITION_TABLE_CUSTOM=y
CONFIG_PARTITION_TABLE_CUSTOM_FILENAME="partitions.csv"
CONFIG_ESPTOOLPY_FLASHSIZE_4MB=y
CONFIG_BT_ENABLED=y
CONFIG_BT_BLUEDROID_ENABLED=y
CONFIG_BT_BLE_ENABLED=y
CONFIG_BT_BLE_42_FEATURES_SUPPORTED=y
CONFIG_ESP_CONSOLE_UART_NUM=1
```
